## config/boards/shields/hummingbird/Kconfig.shield
```kconfig
# Copyright (c) 2022 The ZMK Contributors
# SPDX-License-Identifier: MIT

config SHIELD_HUMMINGBIRD_LEFT
	def_bool $(shields_list_contains,hummingbird_left)

config SHIELD_HUMMINGBIRD_RIGHT
	def_bool $(shields_list_contains,hummingbird_right)
```

## config/west.yml
```yaml
manifest:
  remotes:
    - name: zmkfirmware
      url-base: https://github.com/zmkfirmware
    - name: nickconway
      url-base: https://github.com/nickconway
  projects:
    - name: zmk
      remote: nickconway
      revision: dev
      import: app/west.yml
  self:
    path: config
```
