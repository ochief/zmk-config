// includes
#include			<behaviors.dtsi>
#include			<dt-bindings/zmk/keys.h>
#include			<dt-bindings/zmk/bt.h>
#include            "zmk-helpers/helper.h"

// layers
#define DEF			0
#define NUM 		1
#define NAV 		2
#define MIS			3
#define MOU         4

/* Key Position Groups */
#define KEYS_L      0 1 2 3 4 10 11 12 13 14 20 21 22  // left-hand keys
#define KEYS_R      5 6 7 8 9 15 16 17 18 19 23 24 25  // right-hand keys
#define THUMBS      26 27 28 29                        // thumb keys

// default
#define DEF_NAV_SPC &lt NAV SPACE
#define DEF_NUM_SFT &lst NUM LSHFT
#define DEF_MOUSE   &tog MOU

#define DEF_R		&hml LGUI R
#define DEF_S		&hml LALT S
#define DEF_N		&hml LSFT N
#define DEF_T		&hml LCTL T
#define DEF_H		&hmr LCTL H
#define DEF_E		&hmr LSFT E
#define DEF_I		&hmr LALT I
#define DEF_A		&hmr LGUI A

#define DEF_COMMA   &mm_com_sem
#define DEF_DOT     &mm_dot_col

#define DEF_TOG_MIC &kp F21
#define DEF_SHA_SCR &kp F22
#define DEF_UNDO    &kp LC(Z)
#define DEF_REDO    &kp LC(Y)
#define DEF_BACK_WD &kp LC(BSPC)

// navigation
#define NAV_TAB     &hml LCTL TAB
#define NAV_SWAP    &hml LSFT LC(LA(TAB))
#define NAV_INCOG   &hml LALT LC(N)
#define NAV_SCREENS &hml LGUI LG(LS(S))
#define NAV_COPY    &hm  RSFT LC(C)

#define NAV_SEL_LI  &kp LA(LS(I))
#define NAV_TAB_LE  &kp LC(PG_UP)
#define NAV_TAB_RI  &kp LC(PG_DN)
#define NAV_CUT     &kp LC(X)
#define NAV_SEL_AL  &kp LC(A)
#define NAV_CLO_APP &kp LA(F4)
#define NAV_THREAD  &kp LC(LS(T))
#define NAV_TAB_NE  &kp LC(T)
#define NAV_PASTE   &kp LC(V)

#define NAV_SWI_LE  &mm_switch_left
#define NAV_SWI_RI  &mm_switch_right
#define NAV_UP      &mm_up_pgup
#define NAV_DOWN    &mm_down_pgdn
#define NAV_LEFT    &mm_left_home
#define NAV_RIGHT   &mm_right_end

// number
#define NUM_N0      &mm_num_0
#define NUM_N1      &mm_num_1
#define NUM_N2      &mm_num_2
#define NUM_N3      &mm_num_3
#define NUM_N4      &mm_num_4
#define NUM_N5      &mm_num_5
#define NUM_N6      &mm_num_6
#define NUM_N7      &mm_num_7
#define NUM_N8      &mm_num_8
#define NUM_N9      &mm_num_9
#define NUM_AMPS    &mm_amps_pou

#define NUM_MINUS   &hml LCTL MINUS
#define NUM_UNDER   &hml LSFT UNDER
#define NUM_STAR    &hml LALT STAR
#define NUM_PERCENT &hml LGUI PERCENT
#define NUM_PIPE    &hm  RSFT UK_PIPE    

// miscellaneous
#define MIS_BT_1    &bt BT_SEL 1
#define MIS_BT_2    &bt BT_SEL 2
#define MIS_BT_3    &bt BT_SEL 3

#define MIS_VOL_DN  &kp C_VOL_DN
#define MIS_VOL_MU  &kp C_MUTE
#define MIS_VOL_UP  &kp C_VOL_UP
#define MIS_CAD     &kp LC(LA(DEL))
#define MIS_BRI_DN  &kp C_BRI_DN
#define MIS_BRI_UP  &kp C_BRI_UP
#define MIS_BITWAR  &kp LC(LS(L))
#define MIS_GENERAT &kp LC(LS(N9))
#define MIS_SLEEP   &kp F10

// UK symbols
#define UK_HASH     &kp NUHS
#define UK_DQT      &kp AT
#define UK_AT       &kp DQT
#define UK_TILDE    &kp TILDE2
#define UK_GRAVE    &kp GRAVE
#define UK_BSLH     &kp NUBS
#define UK_EURO     &kp LC(LA(N4))
#define UK_PIPE     PIPE2
#define UK_POUND    HASH 

// other
#define XXXXXXXXXX	&none
#define __________  &trans
#define ___XXXX___  &trans